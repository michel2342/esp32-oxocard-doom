## components/prboom-esp32-compat/Kconfig.projbuild
```kconfig
menu "ESP32-Doom platform-specific configuration"

choice DOOM_HARDWARE
	prompt "Hardware to run on"
	default HW_WROVERKIT_V2
	help
		This emulator can run on various types of hardware. Select what you have here. Warning: The hardware does need to have 4MiB PSRAM installed

config HW_WROVERKIT_V1
	bool "ESP_Wrover_Kit v1 (red PCB)"

config HW_WROVERKIT_V2
	bool "ESP_Wrover_Kit v2/v3 (shiny/matte black PCB)"

config HW_OXOCARD
	bool "Oxocard"
	help
		Select this for any Oxocard model. Configure the LCD pins, button GPIOs, and buzzer GPIO below to match your specific board.

config HW_CUSTOM
	bool "Custom hardware"

endchoice

# True when the user must specify GPIO pins manually
config HW_USER_PINS
	bool
	default y if HW_CUSTOM
	default y if HW_OXOCARD

choice HW_LCD_TYPE_SEL
	prompt "LCD type"
	default HW_LCD_TYPE_ILI
	depends on HW_USER_PINS || HW_WROVERKIT_V2

config HW_LCD_TYPE_ILI
	bool "ILI9341 LCD"

config HW_LCD_TYPE_ST
	bool "ST7789V LCD"

config HW_LCD_TYPE_ST7735
	bool "ST7735 LCD"

endchoice

config HW_WROVERKIT
	bool
	default n if HW_CUSTOM
	default n if HW_OXOCARD
	default y if HW_WROVERKIT_V1
	default y if HW_WROVERKIT_V2


config HW_LCD_TYPE
	int
	default 0 if HW_WROVERKIT_V1
	default 0 if HW_LCD_TYPE_ILI
	default 1 if HW_LCD_TYPE_ST
	default 2 if HW_LCD_TYPE_ST7735


config HW_LCD_MOSI_GPIO_CUST
	int "LCD MOSI pin"
	depends on HW_USER_PINS
	range 0 39
	default 13

config HW_LCD_CLK_GPIO_CUST
	int "LCD CLK pin"
	depends on HW_USER_PINS
	range 0 39
	default 14

config HW_LCD_CS_GPIO_CUST
	int "LCD CS pin"
	depends on HW_USER_PINS
	range 0 39
	default 15

config HW_LCD_DC_GPIO_CUST
	int "LCD DC pin"
	depends on HW_USER_PINS
	range 0 39
	default 27

config HW_LCD_RESET_GPIO_CUST
	int "LCD RESET pin"
	depends on HW_USER_PINS
	range 0 39
	default 4

config HW_LCD_BL_GPIO_CUST
	int "LCD Backlight Enable pin"
	depends on HW_USER_PINS
	range 0 39
	default 19

config HW_INV_BL_CUST
	bool "Invert backlight output"
	default n
	depends on HW_USER_PINS

# ST7735 128x128 panels sometimes have a column/row offset in their address space
config HW_LCD_XOFFSET
	int "LCD X (column) offset"
	depends on HW_LCD_TYPE_ST7735
	range 0 10
	default 0
	help
		Some 128x128 ST7735 panels have a non-zero starting column address. Check your panel datasheet or try small values if the image is shifted.

config HW_LCD_YOFFSET
	int "LCD Y (row) offset"
	depends on HW_LCD_TYPE_ST7735
	range 0 10
	default 0
	help
		Some 128x128 ST7735 panels have a non-zero starting row address.


config HW_INV_BL
	bool
	default HW_INV_BL_CUST if HW_USER_PINS
	default n if HW_WROVERKIT_V1
	default y if HW_WROVERKIT_V2

config HW_LCD_MOSI_GPIO
	int
	default HW_LCD_MOSI_GPIO_CUST if HW_USER_PINS
	default 23 if HW_WROVERKIT

config HW_LCD_CLK_GPIO
	int
	default HW_LCD_CLK_GPIO_CUST if HW_USER_PINS
	default 19 if HW_WROVERKIT

config HW_LCD_CS_GPIO
	int
	default HW_LCD_CS_GPIO_CUST if HW_USER_PINS
	default 22 if HW_WROVERKIT

config HW_LCD_DC_GPIO
	int
	default HW_LCD_DC_GPIO_CUST if HW_USER_PINS
	default 21 if HW_WROVERKIT

config HW_LCD_RESET_GPIO
	int
	default HW_LCD_RESET_GPIO_CUST if HW_USER_PINS
	default 18 if HW_WROVERKIT

config HW_LCD_BL_GPIO
	int
	default HW_LCD_BL_GPIO_CUST if HW_USER_PINS
	default 5 if HW_WROVERKIT


config HW_PSX_ENA
	bool "Enable PSX controller input"
	default n if HW_OXOCARD
	default y
	help
		If you connect a PSX/PS2 controller to the following GPIOs, you can control the game.


config HW_PSX_CLK
	int "PSX controller CLK GPIO pin"
	depends on HW_PSX_ENA
	range 1 35
	default 14

config HW_PSX_DAT
	int "PSX controller DATa GPIO pin"
	depends on HW_PSX_ENA
	range 1 35
	default 27

config HW_PSX_ATT
	int "PSX controller ATTention GPIO pin"
	depends on HW_PSX_ENA
	range 1 35
	default 4

config HW_PSX_CMD
	int "PSX controller CoMmanD GPIO pin"
	depends on HW_PSX_ENA
	range 1 35
	default 2

# --- Oxocard button input ---

config HW_OXOCARD_INPUT
	bool "Enable Oxocard 6-button input"
	default y if HW_OXOCARD
	help
		Maps 6 GPIO buttons to Doom controls. The Strafe button acts as a modifier: when held, Turn Left and Turn Right become Strafe Left and Strafe Right. Note: GPIO 36-39 on ESP32 are input-only and do not support internal pull-ups; use external pull-ups on those pins.

config HW_OXOCARD_BTN_FWD_GPIO
	int "Forward button GPIO"
	depends on HW_OXOCARD_INPUT
	range 0 39
	default 0

config HW_OXOCARD_BTN_BACK_GPIO
	int "Back button GPIO"
	depends on HW_OXOCARD_INPUT
	range 0 39
	default 0

config HW_OXOCARD_BTN_TURNL_GPIO
	int "Turn Left button GPIO"
	depends on HW_OXOCARD_INPUT
	range 0 39
	default 0

config HW_OXOCARD_BTN_TURNR_GPIO
	int "Turn Right button GPIO"
	depends on HW_OXOCARD_INPUT
	range 0 39
	default 0

config HW_OXOCARD_BTN_SHOOT_GPIO
	int "Shoot button GPIO"
	depends on HW_OXOCARD_INPUT
	range 0 39
	default 0

config HW_OXOCARD_BTN_STRAFE_GPIO
	int "Strafe modifier button GPIO"
	depends on HW_OXOCARD_INPUT
	range 0 39
	default 0

# --- Oxocard buzzer ---

config HW_OXOCARD_BUZZER_GPIO
	int "Buzzer GPIO pin"
	depends on HW_OXOCARD
	range 0 39
	default 0
	help
		GPIO connected to the piezo buzzer. Used for sound effects via PWM tone generation (ESP32 LEDC peripheral). Set to the correct pin for your board.

endmenu
```
